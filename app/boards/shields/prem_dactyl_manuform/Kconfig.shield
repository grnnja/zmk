## app/boards/shields/prem_dactyl_manuform/Kconfig.shield
```kconfig
# Copyright (c) 2020 Pete Johanson
# SPDX-License-Identifier: MIT

config SHIELD_PREM_DACTYL_MANUFORM_LEFT
	def_bool $(shields_list_contains,prem_dactyl_manuform_left)

config SHIELD_PREM_DACTYL_MANUFORM_RIGHT
	def_bool $(shields_list_contains,prem_dactyl_manuform_right)
```
